## configs/orangepi_pc_lxc_defconfig
```kconfig
BR2_arm=y
BR2_cortex_a7=y
BR2_ARM_FPU_VFPV4=y
BR2_PACKAGE_HOST_LINUX_HEADERS_CUSTOM_6_12=y
BR2_TOOLCHAIN_BUILDROOT_CXX=y
BR2_GLOBAL_PATCH_DIR="board/orangepi/orangepi-pc/patches"
BR2_DOWNLOAD_FORCE_CHECK_HASHES=y
BR2_TARGET_GENERIC_HOSTNAME="OrangePi_PC"
BR2_TARGET_GENERIC_ISSUE="Welcome to Buildroot for the Orange Pi PC"
BR2_SYSTEM_DHCP="eth0"
BR2_ROOTFS_POST_BUILD_SCRIPT="board/orangepi/common/post-build.sh"
BR2_ROOTFS_POST_IMAGE_SCRIPT="support/scripts/genimage.sh"
BR2_ROOTFS_POST_SCRIPT_ARGS="-c $(BINARIES_DIR)/genimage.cfg"
BR2_LINUX_KERNEL=y
BR2_LINUX_KERNEL_CUSTOM_VERSION=y
BR2_LINUX_KERNEL_CUSTOM_VERSION_VALUE="6.12.43"
BR2_LINUX_KERNEL_DEFCONFIG="sunxi"
BR2_LINUX_KERNEL_CONFIG_FRAGMENT_FILES="board/orangepi/orangepi-pc/linux-lxc.fragment"
BR2_LINUX_KERNEL_DTS_SUPPORT=y
BR2_LINUX_KERNEL_INTREE_DTS_NAME="allwinner/sun8i-h3-orangepi-pc"
BR2_PACKAGE_SOCKPERF=y
BR2_PACKAGE_BEARSSL=y
BR2_PACKAGE_LIBSODIUM=y
BR2_PACKAGE_MBEDTLS=y
BR2_PACKAGE_MBEDTLS_PROGRAMS=y
BR2_PACKAGE_MBEDTLS_DTLS_SRTP=y
BR2_PACKAGE_OPENSSL=y
BR2_PACKAGE_LIBOPENSSL_BIN=y
BR2_PACKAGE_WOLFSSL=y
BR2_PACKAGE_WOLFSSL_ALL=y
BR2_PACKAGE_WOLFSSL_SSLV3=y
BR2_PACKAGE_BRIDGE_UTILS=y
BR2_PACKAGE_DNSMASQ=y
BR2_PACKAGE_IPERF3=y
BR2_PACKAGE_IPROUTE2=y
BR2_PACKAGE_SOCAT=y
BR2_PACKAGE_LXC=y
BR2_PACKAGE_UTIL_LINUX=y
BR2_PACKAGE_UTIL_LINUX_MOUNT=y
BR2_PACKAGE_UTIL_LINUX_NSENTER=y
BR2_PACKAGE_UTIL_LINUX_PIVOT_ROOT=y
BR2_PACKAGE_UTIL_LINUX_SCHEDUTILS=y
BR2_PACKAGE_UTIL_LINUX_SWITCH_ROOT=y
BR2_PACKAGE_UTIL_LINUX_UNSHARE=y
BR2_TARGET_ROOTFS_CPIO_GZIP=y
BR2_TARGET_ROOTFS_EXT2=y
BR2_TARGET_ROOTFS_EXT2_4=y
BR2_TARGET_ROOTFS_INITRAMFS=y
# BR2_TARGET_ROOTFS_TAR is not set
BR2_TARGET_UBOOT=y
BR2_TARGET_UBOOT_BUILD_SYSTEM_KCONFIG=y
BR2_TARGET_UBOOT_CUSTOM_VERSION=y
BR2_TARGET_UBOOT_CUSTOM_VERSION_VALUE="2024.01"
BR2_TARGET_UBOOT_BOARD_DEFCONFIG="orangepi_pc"
BR2_TARGET_UBOOT_NEEDS_DTC=y
BR2_TARGET_UBOOT_NEEDS_PYLIBFDT=y
BR2_TARGET_UBOOT_NEEDS_OPENSSL=y
BR2_TARGET_UBOOT_FORMAT_CUSTOM=y
BR2_TARGET_UBOOT_FORMAT_CUSTOM_NAME="u-boot-sunxi-with-spl.bin"
BR2_PACKAGE_HOST_GENIMAGE=y
```

## package/lxc/Config.in
```kconfig
config BR2_PACKAGE_LXC
	bool "lxc"
	depends on BR2_TOOLCHAIN_HAS_THREADS
	depends on BR2_USE_MMU # fork()
	# build system forcefully builds a shared library
	depends on !BR2_STATIC_LIBS
	depends on BR2_TOOLCHAIN_GCC_AT_LEAST_4_7 # C++11
	depends on BR2_TOOLCHAIN_HEADERS_AT_LEAST_3_0 # setns() system call
	depends on !BR2_TOOLCHAIN_USES_UCLIBC # no fexecve
	help
	  Linux Containers (LXC), provides the ability to group and
	  isolate of a set of processes in a jail by virtualizing and
	  accounting the kernel resources. It is similar to
	  Linux-Vserver or Openvz.

	  https://linuxcontainers.org/

	  This only select the liblxc library (used for example with libvirt).
	  You need to select other options bellow to also install the lxc-*
	  binary utilities if you need them.

comment "lxc needs a glibc or musl toolchain w/ threads, headers >= 3.0, dynamic library, gcc >= 4.7"
	depends on BR2_USE_MMU
	depends on !BR2_TOOLCHAIN_HAS_THREADS \
		|| !BR2_TOOLCHAIN_GCC_AT_LEAST_4_7 \
		|| !BR2_TOOLCHAIN_HEADERS_AT_LEAST_3_0 \
		|| BR2_STATIC_LIBS \
		|| BR2_TOOLCHAIN_USES_UCLIBC

config BR2_PACKAGE_LXC_TOOLS
    bool "install lxc tools (lxc-* commands)"
    default y
    depends on BR2_PACKAGE_LXC
    help
      Build and install the lxc-* utilities (lxc-create, lxc-start,
      etc.). Disable this option if you only require the liblxc library
      (for example to be used with libvirt utilities).

config BR2_PACKAGE_LXC_TOOLS_MULTICALL
    bool "use the 'lxc' multicall binary"
    default y
    depends on BR2_PACKAGE_LXC_TOOLS
    help
      Build the lxc tools as a unique lxc binary to which other lxc-*
      commands point as symbolic links. This optimizes the package size.
```

## package/sockperf/Config.in
```kconfig
config BR2_PACKAGE_SOCKPERF
    bool "sockperf"
    depends on BR2_INSTALL_LIBSTDCPP
    depends on !BR2_STATIC_LIBS
    help
      sockperf is a network benchmarking utility for testing latency and
      throughput over socket-based communications.
      https://github.com/mellanox/sockperf

comment "sockperf needs a toolchain w/ C++, dynamic library"
     depends on !BR2_INSTALL_LIBSTDCPP || BR2_STATIC_LIBS
```
